/* USER CODE BEGIN Header */
/**
  ******************************************************************************
  * @file           : main.c
  * @brief          : Main program body
  ******************************************************************************
  * @attention
  *
  * <h2><center>&copy; Copyright (c) 2021 STMicroelectronics.
  * All rights reserved.</center></h2>
  *
  * This software component is licensed by ST under BSD 3-Clause license,
  * the "License"; You may not use this file except in compliance with the
  * License. You may obtain a copy of the License at:
  *                        opensource.org/licenses/BSD-3-Clause
  *
  ******************************************************************************
  */
/* USER CODE END Header */
/* Includes ------------------------------------------------------------------*/
#include "main.h"
#include "spi.h"
#include "tim.h"
#include "usart.h"
#include "gpio.h"

/* Private includes ----------------------------------------------------------*/
/* USER CODE BEGIN Includes */
#include "app_tle5012b.h"
#include "Vofa.h"
#include "fw.h"
#include "motor.h"
#include "dwt.h"
#include "math.h"
/* USER CODE END Includes */

/* Private typedef -----------------------------------------------------------*/
/* USER CODE BEGIN PTD */

/* USER CODE END PTD */

/* Private define ------------------------------------------------------------*/
/* USER CODE BEGIN PD */
#define WaveSize 1500
/* USER CODE END PD */

/* Private macro -------------------------------------------------------------*/
/* USER CODE BEGIN PM */

/* USER CODE END PM */

/* Private variables ---------------------------------------------------------*/

/* USER CODE BEGIN PV */
uint8_t Res;//FireWater暂存数据		
Vofa_HandleTypedef jSHandle;//JustFloat框架句柄
DataFrame command_data;//存储串口接收的命令
WavePointer pointer;//存储跟踪曲线的两个下标
Motor motor[4];//存储电机状态
Amp amp;//存储两个轴的幅度
float sin_wave[WaveSize]={0,0.00418877795540388,0.00837748241477061,0.0125660398833526,0.0167543768689814,0.0209424198833570,0.0251300954433375,0.0293173300722283,0.0335040503010715,0.0376901826699345,0.0418756537291996,0.0460603900408522,0.0502443181797696,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-0.00837748241477123,-0.00418877795540475};
/*************************************
中间X——59590    Y——48994
X轴（从正到负）    65452——53856   
Y轴（从正到负）		 56386——41790 
*************************************/
Angle angle;
extern PID_parameter PID1_X;//用于追踪轨迹
extern PID_parameter PID1_Y;
extern PID_parameter PID2_X;//用于快速恢复中点
extern PID_parameter PID2_Y;
/* USER CODE END PV */

/* Private function prototypes -----------------------------------------------*/
void SystemClock_Config(void);
/* USER CODE BEGIN PFP */
void PendulumInit(void);//初始化风力摆
void PID_init(void);
/* USER CODE END PFP */

/* Private user code ---------------------------------------------------------*/
/* USER CODE BEGIN 0 */


/* USER CODE END 0 */

/**
  * @brief  The application entry point.
  * @retval int
  */
int main(void)
{
  /* USER CODE BEGIN 1 */


  /* USER CODE END 1 */

  /* MCU Configuration--------------------------------------------------------*/

  /* Reset of all peripherals, Initializes the Flash interface and the Systick. */
  HAL_Init();

  /* USER CODE BEGIN Init */

  /* USER CODE END Init */

  /* Configure the system clock */
  SystemClock_Config();

  /* USER CODE BEGIN SysInit */

  /* USER CODE END SysInit */

  /* Initialize all configured peripherals */
  MX_GPIO_Init();
  MX_TIM2_Init();
  MX_TIM3_Init();
  MX_SPI1_Init();
  MX_SPI2_Init();
  MX_USART1_UART_Init();
  /* USER CODE BEGIN 2 */
	HAL_TIM_PWM_Start(&htim2, TIM_CHANNEL_1);//开启PWM
	HAL_TIM_PWM_Start(&htim2, TIM_CHANNEL_2);
	HAL_TIM_PWM_Start(&htim2, TIM_CHANNEL_3);
	HAL_TIM_PWM_Start(&htim2, TIM_CHANNEL_4);
	HAL_UART_Receive_IT(&huart1, &Res, 1);
	fw_init();//初始化FireWater，接收
	Vofa_Init(&jSHandle,VOFA_MODE_SKIP);//初始化vofa，用JustFloat，发送
	dwt_init();
	command_data.mode=4;//初始化为停止
	PID_init();
	//PendulumInit();
	angle.Mid_X= 59590;
	angle.Mid_Y=48994;
	HAL_GPIO_WritePin(LED_GPIO_Port,LED_Pin,0);
	HAL_TIM_Base_Start_IT(&htim3);//开启定时器中断1ms,定时器最后初始化,防止初始化其他外设失败
  /* USER CODE END 2 */

  /* Infinite loop */
  /* USER CODE BEGIN WHILE */
	int i=0;
  while (1)
  {
		int a,b;
		a=dwt_getCycles();
//		for(int i =0;i<900;i++){//测试代码所用时间,实测每一次float加法只需要7.5ns,double加法需要10ns(core:400MHz)
//			angle[0]+=angle[1];
//		}
		b=dwt_getCycles();
//		float ang[6];
//		ang[0]=angle.X;
//		ang[1]=angle.Y;
//		ang[2]=motor[0].pwm;
//		ang[3]=motor[1].pwm;
//		ang[4]=motor[2].pwm;
//		ang[5]=motor[3].pwm;
//		Vofa_JustFloat(&jSHandle,ang,6);
		//Vofa_Printf(&jSHandle,"%d\r\n",b-a);
		//float c=(float)sin_wave[i];
//		i+=5;
//		if(i>=9999) i=0;
//		Vofa_JustFloat(&jSHandle,&sin_wave[i],1);
		//motor_ctl(4,1,100);
			float ang[8];
			ang[0]=angle.X;
			ang[1]=angle.Y;
			ang[2]=sin_wave[pointer.p_x]*amp.AX+angle.Mid_X;
			ang[3]=sin_wave[pointer.p_y]*amp.AY+angle.Mid_Y;
			ang[4]=motor[0].pwm;
			ang[5]=PID1_X.Intergral;
			ang[6]=amp.AX;
			ang[7]=angle.X-sin_wave[pointer.p_x]*amp.AX-angle.Mid_X;
			Vofa_JustFloat(&jSHandle,ang,8);
			fw_task();
    /* USER CODE END WHILE */

    /* USER CODE BEGIN 3 */
  }
  /* USER CODE END 3 */
}

/**
  * @brief System Clock Configuration
  * @retval None
  */
void SystemClock_Config(void)
{
  RCC_OscInitTypeDef RCC_OscInitStruct = {0};
  RCC_ClkInitTypeDef RCC_ClkInitStruct = {0};

  /** Supply configuration update enable
  */
  HAL_PWREx_ConfigSupply(PWR_LDO_SUPPLY);
  /** Configure the main internal regulator output voltage
  */
  __HAL_PWR_VOLTAGESCALING_CONFIG(PWR_REGULATOR_VOLTAGE_SCALE1);

  while(!__HAL_PWR_GET_FLAG(PWR_FLAG_VOSRDY)) {}
  /** Initializes the RCC Oscillators according to the specified parameters
  * in the RCC_OscInitTypeDef structure.
  */
  RCC_OscInitStruct.OscillatorType = RCC_OSCILLATORTYPE_HSE;
  RCC_OscInitStruct.HSEState = RCC_HSE_ON;
  RCC_OscInitStruct.PLL.PLLState = RCC_PLL_ON;
  RCC_OscInitStruct.PLL.PLLSource = RCC_PLLSOURCE_HSE;
  RCC_OscInitStruct.PLL.PLLM = 3;
  RCC_OscInitStruct.PLL.PLLN = 96;
  RCC_OscInitStruct.PLL.PLLP = 2;
  RCC_OscInitStruct.PLL.PLLQ = 4;
  RCC_OscInitStruct.PLL.PLLR = 2;
  RCC_OscInitStruct.PLL.PLLRGE = RCC_PLL1VCIRANGE_3;
  RCC_OscInitStruct.PLL.PLLVCOSEL = RCC_PLL1VCOWIDE;
  RCC_OscInitStruct.PLL.PLLFRACN = 0;
  if (HAL_RCC_OscConfig(&RCC_OscInitStruct) != HAL_OK)
  {
    Error_Handler();
  }
  /** Initializes the CPU, AHB and APB buses clocks
  */
  RCC_ClkInitStruct.ClockType = RCC_CLOCKTYPE_HCLK|RCC_CLOCKTYPE_SYSCLK
                              |RCC_CLOCKTYPE_PCLK1|RCC_CLOCKTYPE_PCLK2
                              |RCC_CLOCKTYPE_D3PCLK1|RCC_CLOCKTYPE_D1PCLK1;
  RCC_ClkInitStruct.SYSCLKSource = RCC_SYSCLKSOURCE_PLLCLK;
  RCC_ClkInitStruct.SYSCLKDivider = RCC_SYSCLK_DIV1;
  RCC_ClkInitStruct.AHBCLKDivider = RCC_HCLK_DIV2;
  RCC_ClkInitStruct.APB3CLKDivider = RCC_APB3_DIV2;
  RCC_ClkInitStruct.APB1CLKDivider = RCC_APB1_DIV2;
  RCC_ClkInitStruct.APB2CLKDivider = RCC_APB2_DIV2;
  RCC_ClkInitStruct.APB4CLKDivider = RCC_APB4_DIV2;

  if (HAL_RCC_ClockConfig(&RCC_ClkInitStruct, FLASH_LATENCY_2) != HAL_OK)
  {
    Error_Handler();
  }
}

/* USER CODE BEGIN 4 */
/**
  * @brief Initialize the pendulum, make sure it is stablized to the mid-point
  * @retval None
  * @author Francolin
  */
void PendulumInit(void){
	int i=0;
	while(i<=50){
		if(ReadSpeed()<5&&ReadSpeed_Y()<5){
			i++;
			HAL_Delay(100);
			float m = ReadSpeed();
			Vofa_JustFloat(&jSHandle,&m,1);
			HAL_GPIO_TogglePin(LED_GPIO_Port, LED_Pin);
		}
		else{
			i=0;
			HAL_Delay(100);
			float m = ReadSpeed();
			Vofa_JustFloat(&jSHandle,&m,1);
			HAL_GPIO_TogglePin(LED_GPIO_Port, LED_Pin);
		}
	}
}
void PID_init(void){
	PID1_X.Kp = 15;
	PID1_X.Ki = 0;
	PID1_X.Kd = 800;
	PID1_X.Intergral_max = 1000;
	PID1_X.Output_max=9999;
	
	PID1_Y.Kp = 15;
	PID1_Y.Ki = 0;
	PID1_Y.Kd = 800;
	PID1_Y.Intergral_max = 1000;
	PID1_Y.Output_max=9999;

	PID2_X.Kp = 1;
	PID2_X.Ki = 0;
	PID2_X.Kd = 1.0;
	PID2_X.Intergral_max = 2000;
	PID2_X.Output_max=9999;
	
	PID2_Y.Kp = 1;
	PID2_Y.Ki = 0;
	PID2_Y.Kd = 1.0;
	PID2_Y.Intergral_max = 2000;
	PID2_Y.Output_max=9999;
}
/* USER CODE END 4 */

/**
  * @brief  This function is executed in case of error occurrence.
  * @retval None
  */
void Error_Handler(void)
{
  /* USER CODE BEGIN Error_Handler_Debug */
  /* User can add his own implementation to report the HAL error return state */
  __disable_irq();
  while (1)
  {
		Vofa_Printf(&jSHandle,"ERROR!\r\n");
  }
  /* USER CODE END Error_Handler_Debug */
}

#ifdef  USE_FULL_ASSERT
/**
  * @brief  Reports the name of the source file and the source line number
  *         where the assert_param error has occurred.
  * @param  file: pointer to the source file name
  * @param  line: assert_param error line source number
  * @retval None
  */
void assert_failed(uint8_t *file, uint32_t line)
{
  /* USER CODE BEGIN 6 */
  /* User can add his own implementation to report the file name and line number,
     ex: printf("Wrong parameters value: file %s on line %d\r\n", file, line) */
  /* USER CODE END 6 */
}
#endif /* USE_FULL_ASSERT */

/************************ (C) COPYRIGHT STMicroelectronics *****END OF FILE****/
